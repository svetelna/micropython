## ports/zephyr/boards/mimxrt1050_evk.conf
```kconfig
# Required for zephyr.DiskAccess block devices
CONFIG_DISK_ACCESS=y
CONFIG_DISK_ACCESS_SDHC=y

CONFIG_USB=y
CONFIG_USB_DEVICE_STACK=y
CONFIG_USB_DEVICE_PRODUCT="Zephyr MicroPython"
CONFIG_USB_MASS_STORAGE=y
CONFIG_MASS_STORAGE_DISK_NAME="SDHC"
CONFIG_DISPLAY_MCUX_ELCDIF=y
CONFIG_DISPLAY=y
CONFIG_MCUX_ELCDIF_PANEL_RK043FN02H=y

CONFIG_LVGL_HOR_RES_MAX=320
CONFIG_LVGL_VER_RES_MAX=240
CONFIG_LVGL_BITS_PER_PIXEL=32
CONFIG_LVGL_VDB_SIZE=16
CONFIG_LVGL_DISPLAY_DEV_NAME="ELCDIF_1"
CONFIG_LVGL_BUFFER_ALLOC_STATIC=y
#CONFIG_LVGL_POINTER_KSCAN=y
#CONFIG_LVGL_POINTER_KSCAN_MSGQ_COUNT=10
#CONFIG_LVGL_POINTER_KSCAN_DEV_NAME="FT5336"
```
